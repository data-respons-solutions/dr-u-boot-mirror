## board/datarespons/dr-imx8mm-evk/Kconfig
```kconfig
config SYS_BOARD
	default "dr-imx8mm-evk"

config SYS_VENDOR
	default "datarespons"

config SYS_CONFIG_NAME
	default "dr-imx8mm-evk"

source "board/datarespons/common/Kconfig"
```

## board/datarespons/sdb8000/Kconfig
```kconfig
config SYS_BOARD
	default "sdb8000"

config SYS_VENDOR
	default "datarespons"

config SYS_CONFIG_NAME
	default "sdb8000"

source "board/datarespons/common/Kconfig"
```

## board/datarespons/vhgw/Kconfig
```kconfig
config SYS_BOARD
	default "vhgw"

config SYS_VENDOR
	default "datarespons"

config SYS_CONFIG_NAME
	default "vhgw"

source "board/datarespons/common/Kconfig"
```

## configs/cargotec_sdp_factory_defconfig
```kconfig
CONFIG_ARM=y
CONFIG_ARCH_MX6=y
CONFIG_SYS_TEXT_BASE=0x17800000
CONFIG_TARGET_CARGOTEC=y
CONFIG_SECURE_BOOT=y
CONFIG_SYS_EXTRA_OPTIONS="IMX_CONFIG=board/datarespons/cargotec/mx6dl.cfg,MX6QDL,SECURE_BOOT"
CONFIG_BOOTDELAY=0
CONFIG_AUTOBOOT_NOABORT=y
CONFIG_HUSH_PARSER=y
CONFIG_CMD_BOOTZ=y
CONFIG_CMD_MMC=y
CONFIG_CMD_I2C=y
CONFIG_CMD_USB=y
CONFIG_CMD_USB_MASS_STORAGE=y
CONFIG_CMD_GPIO=y
CONFIG_CMD_DHCP=y
CONFIG_CMD_MII=y
CONFIG_CMD_PING=y
CONFIG_CMD_CACHE=y
CONFIG_CMD_EXT2=y
CONFIG_CMD_EXT4=y
CONFIG_CMD_EXT4_WRITE=y
CONFIG_CMD_FAT=y
CONFIG_CMD_FS_GENERIC=y
CONFIG_USB=y
CONFIG_USB_STORAGE=y
CONFIG_USB_GADGET=y
CONFIG_CI_UDC=y
CONFIG_USB_GADGET_DOWNLOAD=y
CONFIG_USB_GADGET_VENDOR_NUM=0x15a2
CONFIG_USB_GADGET_PRODUCT_NUM=0x1111
CONFIG_USB_GADGET_MANUFACTURER="datarespons"
CONFIG_OF_LIBFDT=y
CONFIG_DEFAULT_FDT_FILE	"/boot/cargotec_revA.dtb"
CONFIG_SPL_GPIO_SUPPORT=y
CONFIG_SPL_LIBCOMMON_SUPPORT=y
CONFIG_SPL_LIBGENERIC_SUPPORT=y
CONFIG_SPL_MMC_SUPPORT=y
CONFIG_SPL_SERIAL_SUPPORT=y
CONFIG_SPL_LIBDISK_SUPPORT=y
CONFIG_SPL_WATCHDOG_SUPPORT=y
CONFIG_SPL=y
CONFIG_SPL_I2C_SUPPORT=y
CONFIG_MX6_DDRCAL=y
CONFIG_CMD_PART=y
CONFIG_PARTITIONS=y
CONFIG_EFI_PARTITION=y
CONFIG_PARTITION_UUIDS=y
CONFIG_PARTITION_TYPE_GUID=y
CONFIG_MMC_HW_PARTITIONING=y
CONFIG_SUPPORT_EMMC_BOOT=y
CONFIG_FSL_CAAM=y
CONFIG_BOOT_USB_INITRD=y
CONFIG_SHA256=y
CONFIG_SPL_USB_GADGET_SUPPORT=y
CONFIG_SPL_USB_SDP_SUPPORT=y
CONFIG_SPL_USB_HOST_SUPPORT=y
CONFIG_FACTORY_BOOT=y
```

## configs/vhgw_defconfig
```kconfig
CONFIG_ARM=y
CONFIG_ARCH_IMX8M=y
CONFIG_SYS_TEXT_BASE=0x40200000
CONFIG_SYS_MALLOC_LEN=0x2000000
CONFIG_SYS_MALLOC_F_LEN=0x10000
CONFIG_SPL_GPIO=y
CONFIG_SPL_LIBCOMMON_SUPPORT=y
CONFIG_SPL_LIBGENERIC_SUPPORT=y
CONFIG_NR_DRAM_BANKS=2
CONFIG_ENV_SIZE=0x4000
CONFIG_SYS_I2C_MXC_I2C1=y
CONFIG_SYS_I2C_MXC_I2C2=y
CONFIG_SYS_I2C_MXC_I2C3=y
CONFIG_DM_GPIO=y
CONFIG_SPL_TEXT_BASE=0x912000
CONFIG_TARGET_VHGW=y
CONFIG_SPL_SERIAL=y
CONFIG_SPL_DRIVERS_MISC=y
CONFIG_SPL=y
CONFIG_SPL_IMX_ROMAPI_LOADADDR=0x40400000
CONFIG_DEFAULT_DEVICE_TREE="vhgw"
CONFIG_SYS_LOAD_ADDR=0x40600000
CONFIG_FIT=y
CONFIG_FIT_EXTERNAL_OFFSET=0x3000
CONFIG_SPL_LOAD_FIT=y
# CONFIG_USE_SPL_FIT_GENERATOR is not set
CONFIG_OF_SYSTEM_SETUP=y
CONFIG_DEFAULT_FDT_FILE="imx8mn-ddr3l-evk.dtb"
CONFIG_ARCH_MISC_INIT=y
CONFIG_BOARD_EARLY_INIT_F=y
CONFIG_BOARD_LATE_INIT=y
CONFIG_SPL_BOARD_INIT=y
CONFIG_SPL_BOOTROM_SUPPORT=y
CONFIG_SPL_SEPARATE_BSS=y
CONFIG_SYS_MMCSD_RAW_MODE_U_BOOT_USE_SECTOR=y
CONFIG_SYS_MMCSD_RAW_MODE_U_BOOT_SECTOR=0x300
CONFIG_SPL_I2C=y
CONFIG_SPL_POWER=y
CONFIG_SPL_WATCHDOG=y
CONFIG_HUSH_PARSER=y
CONFIG_SYS_PROMPT="u-boot=> "
CONFIG_CMD_CLK=y
CONFIG_CMD_FUSE=y
CONFIG_CMD_GPIO=y
CONFIG_CMD_I2C=y
CONFIG_CMD_MMC=y
CONFIG_CMD_CACHE=y
CONFIG_CMD_REGULATOR=y
CONFIG_CMD_FAT=y
CONFIG_CMD_SF=y
CONFIG_CMD_USB=y
CONFIG_CMD_USB_MASS_STORAGE=y
CONFIG_OF_CONTROL=y
CONFIG_SPL_OF_CONTROL=y
CONFIG_ENV_IS_NOWHERE=y
CONFIG_SPL_ENV_IS_NOWHERE=y
CONFIG_SYS_RELOC_GD_ENV_ADDR=y
CONFIG_SPL_DM=y
CONFIG_SPL_CLK_COMPOSITE_CCF=y
CONFIG_CLK_COMPOSITE_CCF=y
CONFIG_SPL_CLK_IMX8MN=y
CONFIG_CLK_IMX8MN=y
CONFIG_MXC_GPIO=y
CONFIG_DM_I2C=y
CONFIG_SYS_I2C_MXC=y
CONFIG_EFI_PARTITION=y
CONFIG_SUPPORT_EMMC_RPMB=y
CONFIG_SUPPORT_EMMC_BOOT=y
CONFIG_MMC_IO_VOLTAGE=y
CONFIG_MMC_UHS_SUPPORT=y
CONFIG_MMC_HS400_ES_SUPPORT=y
CONFIG_MMC_HS400_SUPPORT=y
CONFIG_FSL_USDHC=y
CONFIG_DM_SPI_FLASH=y
CONFIG_MXC_SPI=y
CONFIG_SF_DEFAULT_SPEED=40000000
CONFIG_SPI_FLASH_BAR=y
CONFIG_SPI_FLASH_STMICRO=y
CONFIG_SPI_FLASH_MACRONIX=y
CONFIG_SPL_DM_SPI_FLASH=y
CONFIG_SPL_DM_SPI=y
CONFIG_SPL_SPI=y
CONFIG_SPL_SPI_LOAD=y
CONFIG_SPL_SPI_FLASH_SUPPORT=y
CONFIG_SYS_SPI_U_BOOT_OFFS=0x050000
CONFIG_SYS_SPI_U_BOOT2_OFFS=0x1F0000
CONFIG_PHYLIB=y
CONFIG_PHY_ATHEROS=y
CONFIG_DM_ETH=y
CONFIG_PHY_GIGE=y
CONFIG_FEC_MXC=y
CONFIG_MII=y
CONFIG_PINCTRL=y
CONFIG_SPL_PINCTRL=y
CONFIG_PINCTRL_IMX8M=y
CONFIG_DM_PMIC=y
CONFIG_SPL_DM_PMIC_BD71837=y
CONFIG_DM_REGULATOR=y
CONFIG_DM_REGULATOR_FIXED=y
CONFIG_DM_REGULATOR_GPIO=y
CONFIG_MXC_UART=y
CONFIG_SPI=y
CONFIG_DM_SPI=y
CONFIG_NXP_FSPI=y
CONFIG_SYSRESET=y
CONFIG_SYSRESET_PSCI=y
CONFIG_DM_THERMAL=y
CONFIG_IMX_TMU=y
CONFIG_FS_EXT4=y
CONFIG_USB=y
CONFIG_USB_STORAGE=y
CONFIG_DM_USB=y
CONFIG_USB_EHCI_HCD=y
CONFIG_USB_GADGET=y
CONFIG_USB_GADGET_MANUFACTURER="DATARESPONS"
CONFIG_USB_GADGET_VENDOR_NUM=0x0525
CONFIG_USB_GADGET_PRODUCT_NUM=0xa4a8
CONFIG_CI_UDC=y
CONFIG_OF_LIBFDT_OVERLAY=y
CONFIG_CMD_DR_NVRAM=y
CONFIG_CMD_DR_SYSTEM_BOOT=y
CONFIG_DR_NVRAM_BUS=0
CONFIG_DR_NVRAM_CS=0
CONFIG_DR_NVRAM_SPEED=10000000
CONFIG_DR_NVRAM_MODE_0
CONFIG_DR_NVRAM_SECTION_A_START=0x390000
CONFIG_DR_NVRAM_SECTION_A_SIZE=0x010000
CONFIG_DR_NVRAM_SECTION_B_START=0x3A0000
CONFIG_DR_NVRAM_SECTION_B_SIZE=0x010000
```
